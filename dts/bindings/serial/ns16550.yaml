## dts/bindings/serial/ns16550.yaml
```yaml
description: ns16550 UART

compatible: "ns16550"

include: [uart-controller.yaml, pcie-device.yaml, pinctrl-device.yaml, reset-device.yaml]

properties:
  reg-shift:
    type: int
    required: true
    description: quantity to shift the register offsets by

  pcp:
    type: int
    description: custom clock (PRV_CLOCK_PARAMS, if supported)

  dlf:
    type: int
    description: divisor latch fraction (DLF, if supported)

  fifo-size:
    type: int
    description: Size of FIFO

  io-mapped:
    type: boolean
    description: specify registers are IO mapped or memory mapped

  software-reset:
    type: boolean
    description: If present, the driver will perform a software reset on the UART
      instance during initialization using the Software Reset Register (SRR) available
      in some implementations of the Synopsys DesignWare UART. Use this property only
      for UARTs that have the SRR.

  rts-ctrl:
    type: boolean
    description: Support RTS signal controlled by SW

  allow-sleep:
    type: int
    default: 0
    description: When set to 1, the driver keeps the UART break condition asserted
      across suspend/resume (uart_ns16550 sets UART_LINE_CTRL_BRK). Use for links,
      such as HCI, that should park the line while the SoC sleeps. Defaults to 0.
```
